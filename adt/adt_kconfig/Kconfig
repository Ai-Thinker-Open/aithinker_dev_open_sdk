## application/laseremit_demo/vendor/bl602/app_config/Kconfig
```kconfig
menu "application"
menu "laseremit_demo"
menu "AIIO_GPIO_CFG"
choice GPIO_LASEREMIT_PORT
   	bool "aiio_GPIO_LASEREMIT_PORT"
   	default GPIO_LASEREMIT_PORTB
config GPIO_LASEREMIT_PORTA
   	bool "AIIO_GPIO_A"
config GPIO_LASEREMIT_PORTB
   	bool "AIIO_GPIO_B"
endchoice
config GPIO_LASEREMIT_PORT
    	string
    	default AIIO_GPIO_A if GPIO_LASEREMIT_PORTA
    	default AIIO_GPIO_B if GPIO_LASEREMIT_PORTB
choice GPIO_LASEREMIT_PIN
   	bool "aiio_GPIO_LASEREMIT_PIN"
   	default GPIO_LASEREMIT_PIN11
config GPIO_LASEREMIT_PIN0
   	bool "AIIO_GPIO_NUM_0"
config GPIO_LASEREMIT_PIN1
   	bool "AIIO_GPIO_NUM_1"
config GPIO_LASEREMIT_PIN2
   	bool "AIIO_GPIO_NUM_2"
config GPIO_LASEREMIT_PIN3
   	bool "AIIO_GPIO_NUM_3"
config GPIO_LASEREMIT_PIN4
   	bool "AIIO_GPIO_NUM_4"
config GPIO_LASEREMIT_PIN5
   	bool "AIIO_GPIO_NUM_5"
config GPIO_LASEREMIT_PIN6
   	bool "AIIO_GPIO_NUM_6"
config GPIO_LASEREMIT_PIN7
   	bool "AIIO_GPIO_NUM_7"
config GPIO_LASEREMIT_PIN8
   	bool "AIIO_GPIO_NUM_8"
config GPIO_LASEREMIT_PIN9
   	bool "AIIO_GPIO_NUM_9"
config GPIO_LASEREMIT_PIN10
   	bool "AIIO_GPIO_NUM_10"
config GPIO_LASEREMIT_PIN11
   	bool "AIIO_GPIO_NUM_11"
config GPIO_LASEREMIT_PIN12
   	bool "AIIO_GPIO_NUM_12"
config GPIO_LASEREMIT_PIN13
   	bool "AIIO_GPIO_NUM_13"
config GPIO_LASEREMIT_PIN14
   	bool "AIIO_GPIO_NUM_14"
config GPIO_LASEREMIT_PIN15
   	bool "AIIO_GPIO_NUM_15"
endchoice
config GPIO_LASEREMIT_PIN
    	string
    	default AIIO_GPIO_NUM_0   if GPIO_LASEREMIT_PIN0
    	default AIIO_GPIO_NUM_1   if GPIO_LASEREMIT_PIN1
        default AIIO_GPIO_NUM_2   if GPIO_LASEREMIT_PIN2
        default AIIO_GPIO_NUM_3   if GPIO_LASEREMIT_PIN3
        default AIIO_GPIO_NUM_4   if GPIO_LASEREMIT_PIN4
        default AIIO_GPIO_NUM_5   if GPIO_LASEREMIT_PIN5
        default AIIO_GPIO_NUM_6   if GPIO_LASEREMIT_PIN6
        default AIIO_GPIO_NUM_7   if GPIO_LASEREMIT_PIN7
    	default AIIO_GPIO_NUM_8   if GPIO_LASEREMIT_PIN8
    	default AIIO_GPIO_NUM_9   if GPIO_LASEREMIT_PIN9
        default AIIO_GPIO_NUM_10  if GPIO_LASEREMIT_PIN10
        default AIIO_GPIO_NUM_11  if GPIO_LASEREMIT_PIN11
        default AIIO_GPIO_NUM_12  if GPIO_LASEREMIT_PIN12
        default AIIO_GPIO_NUM_13  if GPIO_LASEREMIT_PIN13
        default AIIO_GPIO_NUM_14  if GPIO_LASEREMIT_PIN14
        default AIIO_GPIO_NUM_15  if GPIO_LASEREMIT_PIN15
endmenu
endmenu
endmenu
```

## application/lvgl_demo/vendor/bl618/app_config/Kconfig
```kconfig
menu "application"

menuconfig BSP_USING_CONFIGGURE
    bool "Use menuconfig to generate the configuration"
    default y
    if BSP_USING_CONFIGGURE
        config BSP_LVGL_EN_CONFIG
            bool "Enable LVGL"
            default y
    endif
endmenu
```

## application/mdns_demo/vendor/ln882h/app_config/Kconfig
```kconfig
menu "application"

    config AXK_WIFI_STA_SSID
        string "WiFi Connect SSID"
        default "\"myssid\""
        help
            SSID (network name) for the example to connect to.

    config AXK_WIFI_STA_PASS
        string "WiFi Connect Password"
        default "\"mypassword\""
        help
            WiFi password (WPA or WPA2) for the example to use.
    config AXK_WIFI_STA_CHANNEL
        int "WiFi Connect Channel"
        range 0 13
        default 0
        help
            WiFi channel (network channel) for the example to use.
endmenu
```

## application/nfcconfig/vendor/ln882h/app_config/Kconfig
```kconfig
menu "application"

menuconfig BSP_USING_PERIPHERAL
    bool "Enable peripheral"
    default y
    if BSP_USING_PERIPHERAL
        config BSP_USING_CONFIG
            bool "Use menuconfig to generate the configuration"
            default y
    endif
    if BSP_USING_PERIPHERAL
        config TEST_OUT_GPIO
            string "gpio out function"
            default AIIO_GPIO_NUM_10
            depends on BSP_USING_CONFIG
            help 
            test gpio function
        config TEST_PORT_OUT
            string "gpio out port"
            default AIIO_GPIO_A
            depends on BSP_USING_CONFIG
            help 
            test gpio port function
    endif

endmenu
```

## application/photosensitive_demo/vendor/ln882h/app_config/Kconfig
```kconfig
menu "application"
menu "adc_demo"
menu "AIIO_ADC_CFG"
choice ADC_CHANNEL
   	bool "ADC_CHANNEL"
   	default AIIO_ADC_CH7
config AIIO_ADC_CH0
   	bool "AIIO_ADC_CH0"
config AIIO_ADC_CH1
   	bool "AIIO_ADC_CH1"
config AIIO_ADC_CH2
   	bool "AIIO_ADC_CH2"
config AIIO_ADC_CH3
   	bool "AIIO_ADC_CH3"
config AIIO_ADC_CH4
   	bool "AIIO_ADC_CH4"
config AIIO_ADC_CH5
   	bool "AIIO_ADC_CH5"
config AIIO_ADC_CH6
   	bool "AIIO_ADC_CH6"
config AIIO_ADC_CH7
   	bool "AIIO_ADC_CH7"
endchoice
config ADC_CHANNEL
    	int
    	default 0 if AIIO_ADC_CH0
    	default 1 if AIIO_ADC_CH1
    	default 2 if AIIO_ADC_CH2
    	default 3 if AIIO_ADC_CH3
    	default 4 if AIIO_ADC_CH4
    	default 5 if AIIO_ADC_CH5
    	default 6 if AIIO_ADC_CH6
        default 7 if AIIO_ADC_CH7
        
choice ADC_MODE
   	bool "ADC_MODE"
   	default AIIO_ADC_CONTIUE
config AIIO_ADC_CONTIUE
   	bool "AIIO_ADC_CONTIUE"
config AIIO_ADC_ONE_SHOT
   	bool "AIIO_ADC_ONE_SHOT"
endchoice
config ADC_MODE
    	int
    	default 1     if AIIO_ADC_CONTIUE
    	default 0     if AIIO_ADC_ONE_SHOT

choice ADC_RESOLUTION
   	bool "ADC_RESOLUTION"
   	default AIIO_ADC_RESOLUTION_12
config AIIO_ADC_RESOLUTION_8
   	bool "AIIO_ADC_RESOLUTION_8"
config AIIO_ADC_RESOLUTION_9
   	bool "AIIO_ADC_RESOLUTION_9"
config AIIO_ADC_RESOLUTION_10
   	bool "AIIO_ADC_RESOLUTION_10"
config AIIO_ADC_RESOLUTION_11
   	bool "AIIO_ADC_RESOLUTION_11"
config AIIO_ADC_RESOLUTION_12
   	bool "AIIO_ADC_RESOLUTION_12"
endchoice
config ADC_RESOLUTION
    	int
    	default 0 if AIIO_ADC_RESOLUTION_8
    	default 1 if AIIO_ADC_RESOLUTION_9
    	default 2 if AIIO_ADC_RESOLUTION_10
    	default 3 if AIIO_ADC_RESOLUTION_11
    	default 4 if AIIO_ADC_RESOLUTION_12

choice ADC_VREF
   	bool "ADC_VREF"
   	default AIIO_ADC_VREF_1_0_5_V
config AIIO_ADC_VREF_0_8_V
   	bool "AIIO_ADC_VREF_0_8_V"
config AIIO_ADC_VREF_0_8_5_V
   	bool "AIIO_ADC_VREF_0_8_5_V"
config AIIO_ADC_VREF_0_9_5_V
   	bool "AIIO_ADC_VREF_0_9_5_V"
config AIIO_ADC_VREF_1_0_5_V
   	bool "AIIO_ADC_VREF_1_0_5_V"
config AIIO_ADC_VREF_VCC
   	bool "AIIO_ADC_VREF_VCC"
endchoice
config ADC_VREF
    	int
    	default 0 if AIIO_ADC_VREF_0_8_V
    	default 1 if AIIO_ADC_VREF_0_8_5_V
    	default 2 if AIIO_ADC_VREF_0_9_5_V
    	default 3 if AIIO_ADC_VREF_1_0_5_V
    	default 255 if AIIO_ADC_VREF_VCC
endmenu
endmenu
endmenu
```

## application/pwm_demo/vendor/bl602/app_config/Kconfig
```kconfig
menu "application"

menuconfig BSP_USING_PERIPHERAL
    bool "Enable peripheral"
    default y
    if BSP_USING_PERIPHERAL
        config BSP_USING_CONFIG
            bool "Use menuconfig to generate the configuration"
            default y
    endif
    if BSP_USING_PERIPHERAL
        config TEST_PWM0_PORT
            string "pwm0 out port"
            default AIIO_GPIO_B
            depends on BSP_USING_CONFIG
            help 
            test pwm0 port
        config TEST_PWM0
            string "pwm out function"
            default AIIO_GPIO_NUM_3
            depends on BSP_USING_CONFIG
            help 
            test pwm function
        config TEST_PWM1_PORT
            string "pwm1 out port"
            default AIIO_GPIO_B
            depends on BSP_USING_CONFIG
            help 
            test pwm1 port
        config TEST_PWM1
            string "pwm out port"
            default AIIO_GPIO_NUM_4
            depends on BSP_USING_CONFIG
            help 
            test pwm port function
        config TEST_PWM2_PORT
            string "pwm2 out port"
            default AIIO_GPIO_B
            depends on BSP_USING_CONFIG
            help 
            test pwm2 port
        config TEST_PWM2
            string "pwm out port"
            default AIIO_GPIO_NUM_5
            depends on BSP_USING_CONFIG
            help 
            test pwm port function
    endif

endmenu
```

## application/rd01_demo/vendor/bl602/app_config/Kconfig
```kconfig
menu "application"
    menu "wifi config"
        config AXK_WIFI_MAX_STA_CONN
            int "Maximal STA connections"
            default 2
            help
                Max number of the STA connects to AP.

        config AXK_WIFI_AP_SSID
            string "WiFi AP SSID"
            default "\"flashlight\""

        config AXK_WIFI_AP_PASS
            string "WiFi AP PASSWORD"
            default "\"12345678\""

        config AXK_WIFI_AP_CHANNEL
            int "WIFI AP CHANNEL"
            range 1 13
            default 1

        config AXK_WIFI_SSID_HIDDEN_ENABLE
            bool "SSID HIDDEN ENABLE"
            default n            

        config AXK_WIFI_AP_IP
            string "SET WiFi AP IP"
            default "\"192.168.100.1\""
    endmenu
    menu "mqtt config"
        config AXK_MQTT_URI
            string "MQTT URI"
            default "\"mqtt://120.77.179.113:1883\""

        config AXK_MQTT_HOST
            string "MQTT HOST"
            default "\"mqtt://120.77.179.113\""

        config AXK_MQTT_PORT
            int "MQTT PORT"
            default 1883

        config AXK_MQTT_USERNAME
            string "WiFi MQTT USERNAME"
            default "\"admin\""

        config AXK_MQTT_PASSWORD
            string "WiFi MQTT PASSWORD"
            default "\"public\""

        config AXK_MQTT_CLIENTID
            string "WiFi MQTT CLIENT ID"
            default "\"provider-id\""

        config AXK_MQTT_USER_TOPIC
            string "WiFi MQTT USER TOPIC"
            default "\"flashlightTopic\""
    endmenu
    menu "at config"
        config AXK_AT_ECHO
            bool "AT ECHO ENABLE"
            default y
        config AXK_AT_UART_BAUD
            int "AT UART BAUD"
            default 1000000
    endmenu
    menu "auto sleep config"
        config AXK_AUTO_SLEEP
            bool "AUTO SLEEP ENABLE"
            default y
    endmenu
endmenu
```

## application/shock_demo/vendor/bl602/app_config/Kconfig
```kconfig
menu "application"
menu "shock_demo"
menu "AIIO_GPIO_CFG"
choice GPIO_SHOCK_PORT
   	bool "aiio_GPIO_SHOCK_PORT"
   	default GPIO_SHOCK_PORTB
config GPIO_SHOCK_PORTA
   	bool "AIIO_GPIO_A"
config GPIO_SHOCK_PORTB
   	bool "AIIO_GPIO_B"
endchoice
config GPIO_SHOCK_PORT
    	string
    	default AIIO_GPIO_A if GPIO_SHOCK_PORTA
    	default AIIO_GPIO_B if GPIO_SHOCK_PORTB
choice GPIO_SHOCK_PIN
   	bool "aiio_GPIO_SHOCK_PIN"
   	default GPIO_SHOCK_PIN11
config GPIO_SHOCK_PIN0
   	bool "AIIO_GPIO_NUM_0"
config GPIO_SHOCK_PIN1
   	bool "AIIO_GPIO_NUM_1"
config GPIO_SHOCK_PIN2
   	bool "AIIO_GPIO_NUM_2"
config GPIO_SHOCK_PIN3
   	bool "AIIO_GPIO_NUM_3"
config GPIO_SHOCK_PIN4
   	bool "AIIO_GPIO_NUM_4"
config GPIO_SHOCK_PIN5
   	bool "AIIO_GPIO_NUM_5"
config GPIO_SHOCK_PIN6
   	bool "AIIO_GPIO_NUM_6"
config GPIO_SHOCK_PIN7
   	bool "AIIO_GPIO_NUM_7"
config GPIO_SHOCK_PIN8
   	bool "AIIO_GPIO_NUM_8"
config GPIO_SHOCK_PIN9
   	bool "AIIO_GPIO_NUM_9"
config GPIO_SHOCK_PIN10
   	bool "AIIO_GPIO_NUM_10"
config GPIO_SHOCK_PIN11
   	bool "AIIO_GPIO_NUM_11"
config GPIO_SHOCK_PIN12
   	bool "AIIO_GPIO_NUM_12"
config GPIO_SHOCK_PIN13
   	bool "AIIO_GPIO_NUM_13"
config GPIO_SHOCK_PIN14
   	bool "AIIO_GPIO_NUM_14"
config GPIO_SHOCK_PIN15
   	bool "AIIO_GPIO_NUM_15"
endchoice
config GPIO_SHOCK_PIN
    	string
    	default AIIO_GPIO_NUM_0   if GPIO_SHOCK_PIN0
    	default AIIO_GPIO_NUM_1   if GPIO_SHOCK_PIN1
        default AIIO_GPIO_NUM_2   if GPIO_SHOCK_PIN2
        default AIIO_GPIO_NUM_3   if GPIO_SHOCK_PIN3
        default AIIO_GPIO_NUM_4   if GPIO_SHOCK_PIN4
        default AIIO_GPIO_NUM_5   if GPIO_SHOCK_PIN5
        default AIIO_GPIO_NUM_6   if GPIO_SHOCK_PIN6
        default AIIO_GPIO_NUM_7   if GPIO_SHOCK_PIN7
    	default AIIO_GPIO_NUM_8   if GPIO_SHOCK_PIN8
    	default AIIO_GPIO_NUM_9   if GPIO_SHOCK_PIN9
        default AIIO_GPIO_NUM_10  if GPIO_SHOCK_PIN10
        default AIIO_GPIO_NUM_11  if GPIO_SHOCK_PIN11
        default AIIO_GPIO_NUM_12  if GPIO_SHOCK_PIN12
        default AIIO_GPIO_NUM_13  if GPIO_SHOCK_PIN13
        default AIIO_GPIO_NUM_14  if GPIO_SHOCK_PIN14
        default AIIO_GPIO_NUM_15  if GPIO_SHOCK_PIN15
endmenu
endmenu
endmenu
```
