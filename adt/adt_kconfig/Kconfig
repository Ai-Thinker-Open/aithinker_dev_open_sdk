## adt/adt_kconfig/Kconfig
```kconfig
menu "adt"

menu "SPEC Config"
endmenu

menu "RTOS Config"
endmenu

menu "MAIN Config"
config AIIO_MAIN_STACK                        
	int "AIIO_MAIN_STACK"                     
	default 4096                                 

config AIIO_HEAP_LOG_EN                        
	bool "Turn on heap log printing"                     
	default n                                 

endmenu

menu "TEST Config"
config RF_TEST                        
	bool "RF_TEST"                    
	default y
config GPIO_TEST                        
	bool "GPIO_TEST"                    
	default y  
config RELIABILITY_TEST                         
	bool "RELIABILITY_TEST"                    
	default y
config DEVELOPMENT_KIT_TEST                         
	bool "DEVELOPMENT_KIT_TEST"                    
	default y 
endmenu

menu "ALOG Config"
choice LOG_UART                                         
	bool "Choice Uart"                      
	default AIIO_LOG_UART0                            

	config AIIO_LOG_UART0
		bool "UART0"

	config AIIO_LOG_UART1
		bool "UART1"

	config AIIO_LOG_CUSTOM
		bool "Custom IO (UART0)"

endchoice

config LOG_UART
	int
	default 0 if AIIO_LOG_UART0
	default 1 if AIIO_LOG_UART1

if AIIO_LOG_CUSTOM
	config AIIO_CUSTOM_LOG_TX
		string "Custom UART0 Tx IO"
		default AIIO_GPIO_NUM_17
		help 
		UART0 Select the available IOs based on the multiplexed features supported by the platform

	config AIIO_CUSTOM_LOG_RX
		string "Custom UART0 Rx IO"
		default AIIO_GPIO_NUM_7
		help 
		UART0 Select the available IOs based on the multiplexed features supported by the platform
endif

choice LOG_BAUDRATE
   	bool "Log Baudrate config"
   	default LOG_BAUDRATE_921600

config LOG_BAUDRATE_9600
   	bool "9600"
config LOG_BAUDRATE_57600
   	bool "57600"
config LOG_BAUDRATE_115200
   	bool "115200"
config LOG_BAUDRATE_230400
   	bool "230400"
config LOG_BAUDRATE_460800
   	bool "460800"
config LOG_BAUDRATE_921600
   	bool "921600"
config LOG_BAUDRATE_2000000
   	bool "2000000"
endchoice

config LOG_BAUDRATE
    	int
    	default 9600 	if LOG_BAUDRATE_9600
    	default 57600 	if LOG_BAUDRATE_57600
    	default 115200  if LOG_BAUDRATE_115200
    	default 230400	if LOG_BAUDRATE_230400
    	default 460800	if LOG_BAUDRATE_460800
    	default 921600  if LOG_BAUDRATE_921600
    	default 2000000 if LOG_BAUDRATE_2000000


choice LOG_DEFAULT_LEVEL
   	bool "Default log verbosity"
   	default LOG_DEFAULT_LEVEL_INFO

config LOG_DEFAULT_LEVEL_ASSERT
   	bool "Assert"
config LOG_DEFAULT_LEVEL_ERROR
   	bool "Error"
config LOG_DEFAULT_LEVEL_WARN
   	bool "Warning"
config LOG_DEFAULT_LEVEL_INFO
   	bool "Info"
config LOG_DEFAULT_LEVEL_DEBUG
   	bool "Debug"
config LOG_DEFAULT_LEVEL_VERBOSE
   	bool "Verbose"
endchoice

config LOG_DEFAULT_LEVEL
    	int
    	default 0 if LOG_DEFAULT_LEVEL_ASSERT
    	default 1 if LOG_DEFAULT_LEVEL_ERROR
    	default 2 if LOG_DEFAULT_LEVEL_WARN
    	default 3 if LOG_DEFAULT_LEVEL_INFO
    	default 4 if LOG_DEFAULT_LEVEL_DEBUG
    	default 5 if LOG_DEFAULT_LEVEL_VERBOSE

config LOG_COLORS
   	bool "Use ANSI terminal colors in log output"
   	default y

config LOG_SET_LEVEL
    	bool "Enable log set level"
    	default y

endmenu

menu "Cloud Config"

menu "Aithing Cloud"
config WAN_NETWORK_ENABLE
   	bool "wan network enable"
    default y
config LAN_NETWORK_ENABLE
   	bool "lan network enable"
    default n
config BLE_DISTRIBUTION_NETWORK_ENABLE
   	bool "ble distribution network enable"
    default y
config AP_DISTRIBUTION_NETWORK_ENABLE
   	bool "ap distribution network enable"
    default y
config OTA_ENABLE
   	bool "ota enable"
    default y
endmenu

endmenu

menu "AT Config"

menu "IO"
config AT_UART_PORT
   	string "AT port"
    default AIIO_UART1
config AT_UART_PIN_TX
   	int "tx pin"
    default 4
config AT_UART_PIN_RX
   	int "rx pin"
    default 3
endmenu

menu "TASK"
config AIIO_AT_TASK_PRIO
   	int "AT task prio"
    default 15
endmenu

endmenu

endmenu
```

## application/adc_demo/vendor/bl616/app_config/Kconfig
```kconfig
menu "application"
menu "adc_demo"
menu "AIIO_ADC_CFG"
choice ADC_CHANNEL
   	bool "ADC_CHANNEL"
   	default AIIO_ADC_CH4
config AIIO_ADC_CH0
   	bool "AIIO_ADC_CH0"
config AIIO_ADC_CH1
   	bool "AIIO_ADC_CH1"
config AIIO_ADC_CH2
   	bool "AIIO_ADC_CH2"
config AIIO_ADC_CH3
   	bool "AIIO_ADC_CH3"
config AIIO_ADC_CH4
   	bool "AIIO_ADC_CH4"
config AIIO_ADC_CH5
   	bool "AIIO_ADC_CH5"
config AIIO_ADC_CH6
   	bool "AIIO_ADC_CH6"
config AIIO_ADC_CH7
   	bool "AIIO_ADC_CH7"
config AIIO_ADC_CH8
   	bool "AIIO_ADC_CH8"	
config AIIO_ADC_CH9
   	bool "AIIO_ADC_CH9"	
config AIIO_ADC_CH10
   	bool "AIIO_ADC_CH10"	
config AIIO_ADC_CH11
   	bool "AIIO_ADC_CH11"				
endchoice
config ADC_CHANNEL
    	int
    	default 0 if AIIO_ADC_CH0
    	default 1 if AIIO_ADC_CH1
    	default 2 if AIIO_ADC_CH2
    	default 3 if AIIO_ADC_CH3
    	default 4 if AIIO_ADC_CH4
    	default 5 if AIIO_ADC_CH5
    	default 6 if AIIO_ADC_CH6
        default 7 if AIIO_ADC_CH7
		default 8 if AIIO_ADC_CH8
		default 9 if AIIO_ADC_CH9		
		default 10 if AIIO_ADC_CH10		
		default 11 if AIIO_ADC_CH11		
        
choice ADC_MODE
   	bool "ADC_MODE"
   	default AIIO_ADC_ONE_SHOT
config AIIO_ADC_CONTIUE
   	bool "AIIO_ADC_CONTIUE"
config AIIO_ADC_ONE_SHOT
   	bool "AIIO_ADC_ONE_SHOT"
endchoice
config ADC_MODE
    	int
    	default 1     if AIIO_ADC_CONTIUE
    	default 0     if AIIO_ADC_ONE_SHOT

choice ADC_RESOLUTION
   	bool "ADC_RESOLUTION"
   	default AIIO_ADC_RESOLUTION_16
config AIIO_ADC_RESOLUTION_12
   	bool "AIIO_ADC_RESOLUTION_12"
config AIIO_ADC_RESOLUTION_14
   	bool "AIIO_ADC_RESOLUTION_14"
config AIIO_ADC_RESOLUTION_16
   	bool "AIIO_ADC_RESOLUTION_16"		
endchoice
config ADC_RESOLUTION
    	int
    	default 4 if AIIO_ADC_RESOLUTION_12
		default 5 if AIIO_ADC_RESOLUTION_14
		default 6 if AIIO_ADC_RESOLUTION_16

choice ADC_VREF
   	bool "ADC_VREF"
   	default AIIO_ADC_VREF_3_2_V
config AIIO_ADC_VREF_2_0_V
   	bool "AIIO_ADC_VREF_2_0_V"	
config AIIO_ADC_VREF_3_2_V
   	bool "AIIO_ADC_VREF_3_2_V"

endchoice
config ADC_VREF
    	int
		default 4 if AIIO_ADC_VREF_2_0_V
    	default 5 if AIIO_ADC_VREF_3_2_V

endmenu
endmenu
endmenu
```

## application/aithink_cloud_general/vendor/bl616/app_config/Kconfig
```kconfig
menu "application"
    menu "wifi config"
        config AXK_WIFI_STA_SSID
            string "WiFi Connect SSID"
            default "myssid"
            help
                SSID (network name) for the example to connect to.

        config AXK_WIFI_STA_PASS
            string "WiFi Connect Password"
            default "mypassword"
            help
                WiFi password (WPA or WPA2) for the example to use.
        config AXK_WIFI_STA_CHANNEL
            int "WiFi Connect Channel"
            range 1 13
            default 1
            help
                WiFi channel (network channel) for the example to use.

        config AXK_WIFI_MAX_STA_CONN
            int "Maximal STA connections"
            default 4
            help
                Max number of the STA connects to AP.

        config AXK_WIFI_AP_SSID
            string "WiFi AP SSID"
            default "test_ap"

        config AXK_WIFI_AP_PASS
            string "WiFi AP PASSWORD"
            default "12345678"

        config AXK_WIFI_AP_CHANNEL
            int "WIFI AP CHANNEL"
            range 1 13
            default 1

        config AXK_WIFI_SSID_HIDDEN_ENABLE
            bool "SSID HIDDEN ENABLE"
            default n            

        config AXK_WIFI_AP_IP
            string "SET WiFi AP IP"
            default "192.168.100.1"
    endmenu

    menu "button config"
        config GPIO_BUTTON_PORT
                string "set button led gpio port"
                default AIIO_GPIO_A

        config GPIO_BUTTON_PIN
                string "set button led gpio pin"
                default AIIO_GPIO_NUM_0
    endmenu

    menu "led config"
        config GPIO_R_LED_PORT
                string "set red led gpio port"
                default AIIO_GPIO_A

        config GPIO_R_LED_PIN
                string "set red led gpio pin"
                default AIIO_GPIO_NUM_0

        config GPIO_G_LED_PORT
                string "set green led gpio port"
                default AIIO_GPIO_A

        config GPIO_G_LED_PIN
                string "set green led gpio pin"
                default AIIO_GPIO_NUM_0

        config GPIO_B_LED_PORT
                string "set blue led gpio port"
                default AIIO_GPIO_A

        config GPIO_B_LED_PIN
                string "set blue led gpio pin"
                default AIIO_GPIO_NUM_0
    endmenu

    menu "Data start address"
        config FLASH_RW_START_ADDR
            hex "Flash rw start addr"
            default 0x3F3000
        
        config FLASH_REGION_SIZE
            hex "flash region size"
            default 0x1000
        config DEVICE_INFO_ADDR
            hex "flash device info addr"
            default 0x378000
    endmenu

    menu "chip platform"
        config DEVICE_TYPE
            string "chip platform"
            default "bl618"
    endmenu

    menu "uart0 config"
        config UART0_TX_PIN
                string "set uart0 tx pin"
                default AIIO_GPIO_NUM_0

        config UART0_RX_PIN
                string "set uart0 rx pin"
                default AIIO_GPIO_NUM_0

        config UART0_BAUDRATE
            int "uart0 baudrate"
            default 2000000

        config UART0_RECEIVE_BUFFER_MAX_LEN
            int "uart0 receive buffer max length"
            default 1024
    endmenu

    menu "uart1 config"
        config UART1_TX_PIN
                string "set uart1 tx pin"
                default AIIO_GPIO_NUM_0

        config UART1_RX_PIN
                string "set uart1 rx pin"
                default AIIO_GPIO_NUM_0

        config UART1_BAUDRATE
            int "uart1 baudrate"
            default 2000000

        config UART1_RECEIVE_BUFFER_MAX_LEN
            int "uart1 receive buffer max length"
            default 1024
    endmenu

    menu "module config"
        config WAN_NETWORK_MODULE
                bool "wan network enable"
                default y

        config LAN_NETWORK_MODULE
                bool "LAN network enable"
                default y

        config BLE_DISTRIBUTION_NETWORK
                bool "ble distribution network enable"
                default y

        config AP_DISTRIBUTION_NETWORK
                bool "ap distribution network enable"
                default y

        config OTA_MODULE
                bool "ota module enable"
                default y


    endmenu

endmenu
```

## application/aithink_cloud_xxj/vendor/bl618/app_config/Kconfig
```kconfig
menu "application"

menuconfig BSP_USING_CONFIGGURE
    bool "Use menuconfig to generate the configuration"
    default y
    if BSP_USING_CONFIGGURE
        config BSP_LVGL_EN_CONFIG
            bool "Enable LVGL"
            default y
    endif

    menu "button config"
        config GPIO_BUTTON_PORT
                string "set button led gpio port"
                default AIIO_GPIO_A

        config GPIO_BUTTON_PIN
                string "set button led gpio pin"
                default AIIO_GPIO_NUM_0
    endmenu

    menu "led config"
        config GPIO_R_LED_PORT
                string "set red led gpio port"
                default AIIO_GPIO_A

        config GPIO_R_LED_PIN
                string "set red led gpio pin"
                default AIIO_GPIO_NUM_0

        config GPIO_G_LED_PORT
                string "set green led gpio port"
                default AIIO_GPIO_A

        config GPIO_G_LED_PIN
                string "set green led gpio pin"
                default AIIO_GPIO_NUM_0

        config GPIO_B_LED_PORT
                string "set blue led gpio port"
                default AIIO_GPIO_A

        config GPIO_B_LED_PIN
                string "set blue led gpio pin"
                default AIIO_GPIO_NUM_0
    endmenu

    menu "Data start address"
        config FLASH_RW_START_ADDR
            hex "Flash rw start addr"
            default 0x3F3000
        
        config FLASH_REGION_SIZE
            hex "flash region size"
            default 0x1000
    endmenu

    menu "chip platform"
        config DEVICE_TYPE
            string "chip platform"
            default "bl618"
    endmenu

    menu "uart0 config"
        config UART0_TX_PIN
                string "set uart0 tx pin"
                default AIIO_GPIO_NUM_0

        config UART0_RX_PIN
                string "set uart0 rx pin"
                default AIIO_GPIO_NUM_0

        config UART0_BAUDRATE
            int "uart0 baudrate"
            default 2000000

        config UART0_RECEIVE_BUFFER_MAX_LEN
            int "uart0 receive buffer max length"
            default 1024
    endmenu

    menu "uart1 config"
        config UART1_TX_PIN
                string "set uart1 tx pin"
                default AIIO_GPIO_NUM_0

        config UART1_RX_PIN
                string "set uart1 rx pin"
                default AIIO_GPIO_NUM_0

        config UART1_BAUDRATE
            int "uart1 baudrate"
            default 2000000

        config UART1_RECEIVE_BUFFER_MAX_LEN
            int "uart1 receive buffer max length"
            default 1024
    endmenu

    menu "module config"
        config WAN_NETWORK_MODULE
                bool "wan network enable"
                default y

        config LAN_NETWORK_MODULE
                bool "LAN network enable"
                default y

        config BLE_DISTRIBUTION_NETWORK
                bool "ble distribution network enable"
                default y

        config AP_DISTRIBUTION_NETWORK
                bool "ap distribution network enable"
                default y

        config OTA_MODULE
                bool "ota module enable"
                default y


    endmenu



endmenu
```

## application/at_demo/vendor/ln882h/app_config/Kconfig
```kconfig
menu "application"
    config AT_WIFI_CMD_ENABLE
        bool "ENABLE AT WIFI"
        default y
    config AT_BLE_CMD_ENABLE
        bool "ENABLE AT BLE"
        default y
    config AT_HTTP_CMD_ENABLE
        bool "ENABLE AT HTTP"
        default y
    config AT_MQTT_CMD_ENABLE
        bool "ENABLE AT MQTT"
        default y
    config AT_SOCKET_CMD_ENABLE
        bool "ENABLE AT SOCKET"
        default y
endmenu
```
