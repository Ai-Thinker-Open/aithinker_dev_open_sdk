## application/button_demo/vendor/bl602/app_config/Kconfig
```kconfig
menu "application"
menu "button_demo"
menu "AIIO_GPIO_CFG"
choice GPIO_BUTTON_PORT
   	bool "aiio_GPIO_BUTTON_PORT"
   	default GPIO_BUTTON_PORTB
config GPIO_BUTTON_PORTA
   	bool "AIIO_GPIO_A"
config GPIO_BUTTON_PORTB
   	bool "AIIO_GPIO_B"
endchoice
config GPIO_BUTTON_PORT
    	string
    	default AIIO_GPIO_A if GPIO_BUTTON_PORTA
    	default AIIO_GPIO_B if GPIO_BUTTON_PORTB
choice GPIO_BUTTON_PIN
   	bool "aiio_GPIO_BUTTON_PIN"
   	default GPIO_BUTTON_PIN4
config GPIO_BUTTON_PIN0
   	bool "AIIO_GPIO_NUM_0"
config GPIO_BUTTON_PIN1
   	bool "AIIO_GPIO_NUM_1"
config GPIO_BUTTON_PIN2
   	bool "AIIO_GPIO_NUM_2"
config GPIO_BUTTON_PIN3
   	bool "AIIO_GPIO_NUM_3"
config GPIO_BUTTON_PIN4
   	bool "AIIO_GPIO_NUM_4"
config GPIO_BUTTON_PIN5
   	bool "AIIO_GPIO_NUM_5"
config GPIO_BUTTON_PIN6
   	bool "AIIO_GPIO_NUM_6"
config GPIO_BUTTON_PIN7
   	bool "AIIO_GPIO_NUM_7"
config GPIO_BUTTON_PIN8
   	bool "AIIO_GPIO_NUM_8"
config GPIO_BUTTON_PIN9
   	bool "AIIO_GPIO_NUM_9"
config GPIO_BUTTON_PIN10
   	bool "AIIO_GPIO_NUM_10"
config GPIO_BUTTON_PIN11
   	bool "AIIO_GPIO_NUM_11"
config GPIO_BUTTON_PIN12
   	bool "AIIO_GPIO_NUM_12"
config GPIO_BUTTON_PIN13
   	bool "AIIO_GPIO_NUM_13"
config GPIO_BUTTON_PIN14
   	bool "AIIO_GPIO_NUM_14"
config GPIO_BUTTON_PIN15
   	bool "AIIO_GPIO_NUM_15"
endchoice
config GPIO_BUTTON_PIN
    	string
    	default AIIO_GPIO_NUM_0   if GPIO_BUTTON_PIN0
    	default AIIO_GPIO_NUM_1   if GPIO_BUTTON_PIN1
        default AIIO_GPIO_NUM_2   if GPIO_BUTTON_PIN2
        default AIIO_GPIO_NUM_3   if GPIO_BUTTON_PIN3
        default AIIO_GPIO_NUM_4   if GPIO_BUTTON_PIN4
        default AIIO_GPIO_NUM_5   if GPIO_BUTTON_PIN5
        default AIIO_GPIO_NUM_6   if GPIO_BUTTON_PIN6
        default AIIO_GPIO_NUM_7   if GPIO_BUTTON_PIN7
    	default AIIO_GPIO_NUM_8   if GPIO_BUTTON_PIN8
    	default AIIO_GPIO_NUM_9   if GPIO_BUTTON_PIN9
        default AIIO_GPIO_NUM_10  if GPIO_BUTTON_PIN10
        default AIIO_GPIO_NUM_11  if GPIO_BUTTON_PIN11
        default AIIO_GPIO_NUM_12  if GPIO_BUTTON_PIN12
        default AIIO_GPIO_NUM_13  if GPIO_BUTTON_PIN13
        default AIIO_GPIO_NUM_14  if GPIO_BUTTON_PIN14
        default AIIO_GPIO_NUM_15  if GPIO_BUTTON_PIN15
endmenu
endmenu
endmenu
```

## application/buzzer_demo/vendor/bl618/app_config/Kconfig
```kconfig
menu "application"

menuconfig BSP_USING_PERIPHERAL
    bool "Enable peripheral"
    default y
    if BSP_USING_PERIPHERAL
        config BSP_USING_CONFIG
            bool "Use menuconfig to generate the configuration"
            default y
    endif
    if BSP_USING_PERIPHERAL
        config GPIO_BUZZEE_PIN
            string "gpio in-out function"
            default AIIO_GPIO_NUM_0
            depends on BSP_USING_CONFIG
            help 
            test gpio function
        config GPIO_BUZZEE_PORT
            string "gpio in-out port"
            default AIIO_GPIO_B
            depends on BSP_USING_CONFIG
            help 
            test gpio port function
    endif

endmenu
```

## application/buzzer_demo/vendor/ln882h/app_config/Kconfig
```kconfig
menu "application"
menu "buzzer_demo"
menu "AIIO_GPIO_CFG"
choice GPIO_BUZZEE_PORT
   	bool "aiio_GPIO_BUZZEE_PORT"
   	default GPIO_BUZZEE_PORTB
config GPIO_BUZZEE_PORTA
   	bool "AIIO_GPIO_A"
config GPIO_BUZZEE_PORTB
   	bool "AIIO_GPIO_B"
endchoice
config GPIO_BUZZEE_PORT
    	string
    	default AIIO_GPIO_A if GPIO_BUZZEE_PORTA
    	default AIIO_GPIO_B if GPIO_BUZZEE_PORTB
choice GPIO_BUZZEE_PIN
   	bool "aiio_GPIO_BUZZEE_PIN"
   	default GPIO_BUZZEE_PIN4
config GPIO_BUZZEE_PIN0
   	bool "AIIO_GPIO_NUM_0"
config GPIO_BUZZEE_PIN1
   	bool "AIIO_GPIO_NUM_1"
config GPIO_BUZZEE_PIN2
   	bool "AIIO_GPIO_NUM_2"
config GPIO_BUZZEE_PIN3
   	bool "AIIO_GPIO_NUM_3"
config GPIO_BUZZEE_PIN4
   	bool "AIIO_GPIO_NUM_4"
config GPIO_BUZZEE_PIN5
   	bool "AIIO_GPIO_NUM_5"
config GPIO_BUZZEE_PIN6
   	bool "AIIO_GPIO_NUM_6"
config GPIO_BUZZEE_PIN7
   	bool "AIIO_GPIO_NUM_7"
config GPIO_BUZZEE_PIN8
   	bool "AIIO_GPIO_NUM_8"
config GPIO_BUZZEE_PIN9
   	bool "AIIO_GPIO_NUM_9"
config GPIO_BUZZEE_PIN10
   	bool "AIIO_GPIO_NUM_10"
config GPIO_BUZZEE_PIN11
   	bool "AIIO_GPIO_NUM_11"
config GPIO_BUZZEE_PIN12
   	bool "AIIO_GPIO_NUM_12"
config GPIO_BUZZEE_PIN13
   	bool "AIIO_GPIO_NUM_13"
config GPIO_BUZZEE_PIN14
   	bool "AIIO_GPIO_NUM_14"
config GPIO_BUZZEE_PIN15
   	bool "AIIO_GPIO_NUM_15"
endchoice
config GPIO_BUZZEE_PIN
    	string
    	default AIIO_GPIO_NUM_0   if GPIO_BUZZEE_PIN0
    	default AIIO_GPIO_NUM_1   if GPIO_BUZZEE_PIN1
        default AIIO_GPIO_NUM_2   if GPIO_BUZZEE_PIN2
        default AIIO_GPIO_NUM_3   if GPIO_BUZZEE_PIN3
        default AIIO_GPIO_NUM_4   if GPIO_BUZZEE_PIN4
        default AIIO_GPIO_NUM_5   if GPIO_BUZZEE_PIN5
        default AIIO_GPIO_NUM_6   if GPIO_BUZZEE_PIN6
        default AIIO_GPIO_NUM_7   if GPIO_BUZZEE_PIN7
    	default AIIO_GPIO_NUM_8   if GPIO_BUZZEE_PIN8
    	default AIIO_GPIO_NUM_9   if GPIO_BUZZEE_PIN9
        default AIIO_GPIO_NUM_10  if GPIO_BUZZEE_PIN10
        default AIIO_GPIO_NUM_11  if GPIO_BUZZEE_PIN11
        default AIIO_GPIO_NUM_12  if GPIO_BUZZEE_PIN12
        default AIIO_GPIO_NUM_13  if GPIO_BUZZEE_PIN13
        default AIIO_GPIO_NUM_14  if GPIO_BUZZEE_PIN14
        default AIIO_GPIO_NUM_15  if GPIO_BUZZEE_PIN15
endmenu
endmenu
endmenu
```

## application/doubulelight_demo/vendor/bl602/app_config/Kconfig
```kconfig
menu "application"
menu "doubulelight_demo"
menu "AIIO_GPIO_CFG"
choice GPIO_RED_PORT
   	bool "aiio_gpio_red_port"
   	default GPIO_RED_PORTB
config GPIO_RED_PORTA
   	bool "AIIO_GPIO_A"
config GPIO_RED_PORTB
   	bool "AIIO_GPIO_B"
endchoice
config GPIO_RED_PORT
    	string
    	default AIIO_GPIO_A if GPIO_RED_PORTA
    	default AIIO_GPIO_B if GPIO_RED_PORTB
choice GPIO_RED_PIN
   	bool "aiio_gpio_red_pin"
   	default GPIO_RED_PIN12
config GPIO_RED_PIN0
   	bool "AIIO_GPIO_NUM_0"
config GPIO_RED_PIN1
   	bool "AIIO_GPIO_NUM_1"
config GPIO_RED_PIN2
   	bool "AIIO_GPIO_NUM_2"
config GPIO_RED_PIN3
   	bool "AIIO_GPIO_NUM_3"
config GPIO_RED_PIN4
   	bool "AIIO_GPIO_NUM_4"
config GPIO_RED_PIN5
   	bool "AIIO_GPIO_NUM_5"
config GPIO_RED_PIN6
   	bool "AIIO_GPIO_NUM_6"
config GPIO_RED_PIN7
   	bool "AIIO_GPIO_NUM_7"
config GPIO_RED_PIN8
   	bool "AIIO_GPIO_NUM_8"
config GPIO_RED_PIN9
   	bool "AIIO_GPIO_NUM_9"
config GPIO_RED_PIN10
   	bool "AIIO_GPIO_NUM_10"
config GPIO_RED_PIN11
   	bool "AIIO_GPIO_NUM_11"
config GPIO_RED_PIN12
   	bool "AIIO_GPIO_NUM_12"
config GPIO_RED_PIN13
   	bool "AIIO_GPIO_NUM_13"
config GPIO_RED_PIN14
   	bool "AIIO_GPIO_NUM_14"
config GPIO_RED_PIN15
   	bool "AIIO_GPIO_NUM_15"
endchoice
config GPIO_RED_PIN
    	string
    	default AIIO_GPIO_NUM_0   if GPIO_RED_PIN0
    	default AIIO_GPIO_NUM_1   if GPIO_RED_PIN1
        default AIIO_GPIO_NUM_2   if GPIO_RED_PIN2
        default AIIO_GPIO_NUM_3   if GPIO_RED_PIN3
        default AIIO_GPIO_NUM_4   if GPIO_RED_PIN4
        default AIIO_GPIO_NUM_5   if GPIO_RED_PIN5
        default AIIO_GPIO_NUM_6   if GPIO_RED_PIN6
        default AIIO_GPIO_NUM_7   if GPIO_RED_PIN7
    	default AIIO_GPIO_NUM_8   if GPIO_RED_PIN8
    	default AIIO_GPIO_NUM_9   if GPIO_RED_PIN9
        default AIIO_GPIO_NUM_10  if GPIO_RED_PIN10
        default AIIO_GPIO_NUM_11  if GPIO_RED_PIN11
        default AIIO_GPIO_NUM_12  if GPIO_RED_PIN12
        default AIIO_GPIO_NUM_13  if GPIO_RED_PIN13
        default AIIO_GPIO_NUM_14  if GPIO_RED_PIN14
        default AIIO_GPIO_NUM_15  if GPIO_RED_PIN15
choice GPIO_YELLOW_PORT
   	bool "aiio_gpio_yellow_port"
   	default GPIO_YELLOW_PORTB
config GPIO_YELLOW_PORTA
   	bool "AIIO_GPIO_A"
config GPIO_YELLOW_PORTB
   	bool "AIIO_GPIO_B"
endchoice
config GPIO_YELLOW_PORT
    	string
    	default AIIO_GPIO_A if GPIO_YELLOW_PORTA
    	default AIIO_GPIO_B if GPIO_YELLOW_PORTB
choice GPIO_YELLOW_PIN
   	bool "aiio_gpio_yellow_pin"
   	default GPIO_YELLOW_PIN11
config GPIO_YELLOW_PIN0
   	bool "AIIO_GPIO_NUM_0"
config GPIO_YELLOW_PIN1
   	bool "AIIO_GPIO_NUM_1"
config GPIO_YELLOW_PIN2
   	bool "AIIO_GPIO_NUM_2"
config GPIO_YELLOW_PIN3
   	bool "AIIO_GPIO_NUM_3"
config GPIO_YELLOW_PIN4
   	bool "AIIO_GPIO_NUM_4"
config GPIO_YELLOW_PIN5
   	bool "AIIO_GPIO_NUM_5"
config GPIO_YELLOW_PIN6
   	bool "AIIO_GPIO_NUM_6"
config GPIO_YELLOW_PIN7
   	bool "AIIO_GPIO_NUM_7"
config GPIO_YELLOW_PIN8
   	bool "AIIO_GPIO_NUM_8"
config GPIO_YELLOW_PIN9
   	bool "AIIO_GPIO_NUM_9"
config GPIO_YELLOW_PIN10
   	bool "AIIO_GPIO_NUM_10"
config GPIO_YELLOW_PIN11
   	bool "AIIO_GPIO_NUM_11"
config GPIO_YELLOW_PIN12
   	bool "AIIO_GPIO_NUM_12"
config GPIO_YELLOW_PIN13
   	bool "AIIO_GPIO_NUM_13"
config GPIO_YELLOW_PIN14
   	bool "AIIO_GPIO_NUM_14"
config GPIO_YELLOW_PIN15
   	bool "AIIO_GPIO_NUM_15"
endchoice
config GPIO_YELLOW_PIN
    	string
    	default AIIO_GPIO_NUM_0   if GPIO_YELLOW_PIN0
    	default AIIO_GPIO_NUM_1   if GPIO_YELLOW_PIN1
        default AIIO_GPIO_NUM_2   if GPIO_YELLOW_PIN2
        default AIIO_GPIO_NUM_3   if GPIO_YELLOW_PIN3
        default AIIO_GPIO_NUM_4   if GPIO_YELLOW_PIN4
        default AIIO_GPIO_NUM_5   if GPIO_YELLOW_PIN5
        default AIIO_GPIO_NUM_6   if GPIO_YELLOW_PIN6
        default AIIO_GPIO_NUM_7   if GPIO_YELLOW_PIN7
    	default AIIO_GPIO_NUM_8   if GPIO_YELLOW_PIN8
    	default AIIO_GPIO_NUM_9   if GPIO_YELLOW_PIN9
        default AIIO_GPIO_NUM_10  if GPIO_YELLOW_PIN10
        default AIIO_GPIO_NUM_11  if GPIO_YELLOW_PIN11
        default AIIO_GPIO_NUM_12  if GPIO_YELLOW_PIN12
        default AIIO_GPIO_NUM_13  if GPIO_YELLOW_PIN13
        default AIIO_GPIO_NUM_14  if GPIO_YELLOW_PIN14
        default AIIO_GPIO_NUM_15  if GPIO_YELLOW_PIN15
endmenu
endmenu
endmenu
```

## application/ds18b20_demo/vendor/ln882h/app_config/Kconfig
```kconfig
menu "application"
menu "ds18b20_demo"
menu "AIIO_GPIO_CFG"
choice GPIO_DS18B20_PORT
   	bool "aiio_GPIO_DS18B20_PORT"
   	default GPIO_DS18B20_PORTB
config GPIO_DS18B20_PORTA
   	bool "AIIO_GPIO_A"
config GPIO_DS18B20_PORTB
   	bool "AIIO_GPIO_B"
endchoice
config GPIO_DS18B20_PORT
    	string
    	default AIIO_GPIO_A if GPIO_DS18B20_PORTA
    	default AIIO_GPIO_B if GPIO_DS18B20_PORTB
choice GPIO_DS18B20_PIN
   	bool "aiio_GPIO_DS18B20_PIN"
   	default GPIO_DS18B20_PIN4
config GPIO_DS18B20_PIN0
   	bool "AIIO_GPIO_NUM_0"
config GPIO_DS18B20_PIN1
   	bool "AIIO_GPIO_NUM_1"
config GPIO_DS18B20_PIN2
   	bool "AIIO_GPIO_NUM_2"
config GPIO_DS18B20_PIN3
   	bool "AIIO_GPIO_NUM_3"
config GPIO_DS18B20_PIN4
   	bool "AIIO_GPIO_NUM_4"
config GPIO_DS18B20_PIN5
   	bool "AIIO_GPIO_NUM_5"
config GPIO_DS18B20_PIN6
   	bool "AIIO_GPIO_NUM_6"
config GPIO_DS18B20_PIN7
   	bool "AIIO_GPIO_NUM_7"
config GPIO_DS18B20_PIN8
   	bool "AIIO_GPIO_NUM_8"
config GPIO_DS18B20_PIN9
   	bool "AIIO_GPIO_NUM_9"
config GPIO_DS18B20_PIN10
   	bool "AIIO_GPIO_NUM_10"
config GPIO_DS18B20_PIN11
   	bool "AIIO_GPIO_NUM_11"
config GPIO_DS18B20_PIN12
   	bool "AIIO_GPIO_NUM_12"
config GPIO_DS18B20_PIN13
   	bool "AIIO_GPIO_NUM_13"
config GPIO_DS18B20_PIN14
   	bool "AIIO_GPIO_NUM_14"
config GPIO_DS18B20_PIN15
   	bool "AIIO_GPIO_NUM_15"
endchoice
config GPIO_DS18B20_PIN
    	string
    	default AIIO_GPIO_NUM_0   if GPIO_DS18B20_PIN0
    	default AIIO_GPIO_NUM_1   if GPIO_DS18B20_PIN1
        default AIIO_GPIO_NUM_2   if GPIO_DS18B20_PIN2
        default AIIO_GPIO_NUM_3   if GPIO_DS18B20_PIN3
        default AIIO_GPIO_NUM_4   if GPIO_DS18B20_PIN4
        default AIIO_GPIO_NUM_5   if GPIO_DS18B20_PIN5
        default AIIO_GPIO_NUM_6   if GPIO_DS18B20_PIN6
        default AIIO_GPIO_NUM_7   if GPIO_DS18B20_PIN7
    	default AIIO_GPIO_NUM_8   if GPIO_DS18B20_PIN8
    	default AIIO_GPIO_NUM_9   if GPIO_DS18B20_PIN9
        default AIIO_GPIO_NUM_10  if GPIO_DS18B20_PIN10
        default AIIO_GPIO_NUM_11  if GPIO_DS18B20_PIN11
        default AIIO_GPIO_NUM_12  if GPIO_DS18B20_PIN12
        default AIIO_GPIO_NUM_13  if GPIO_DS18B20_PIN13
        default AIIO_GPIO_NUM_14  if GPIO_DS18B20_PIN14
        default AIIO_GPIO_NUM_15  if GPIO_DS18B20_PIN15
endmenu
endmenu
endmenu
```

## application/gpio_demo/vendor/rtl8711dx/app_config/Kconfig
```kconfig
menu "application"

menuconfig BSP_USING_PERIPHERAL
    bool "Enable peripheral"
    default y
    if BSP_USING_PERIPHERAL
        config BSP_USING_CONFIG
            bool "Use menuconfig to generate the configuration"
            default y
    endif
    if BSP_USING_PERIPHERAL
        config TEST_INOUT_GPIO
            string "gpio in-out function"
            default AIIO_GPIO_NUM_4
            depends on BSP_USING_CONFIG
            help 
            test gpio function
        config TEST_PORT_INOUT
            string "gpio in-out port"
            default AIIO_GPIO_B
            depends on BSP_USING_CONFIG
            help 
            test gpio port function
    endif
    if BSP_USING_PERIPHERAL
        config TEST_OUT_GPIO
            string "gpio out function"
            default AIIO_GPIO_NUM_5
            depends on BSP_USING_CONFIG
            help 
            test gpio function
        config TEST_PORT_OUT
            string "gpio out port"
            default AIIO_GPIO_B
            depends on BSP_USING_CONFIG
            help 
            test gpio port function
    endif

endmenu
```

## application/http_server_demo/vendor/ln882h/app_config/Kconfig
```kconfig
menu "application"
    config AXK_WIFI_STA_SSID
        string "WiFi Connect SSID"
        default "myssid"
        help
            SSID (network name) for the example to connect to.

    config AXK_WIFI_STA_PASS
        string "WiFi Connect Password"
        default "mypassword"
        help
            WiFi password (WPA or WPA2) for the example to use.
    config AXK_WIFI_STA_CHANNEL
        int "WiFi Connect Channel"
        range 1 13
        default 1
        help
            WiFi channel (network channel) for the example to use.

    config AXK_WIFI_MAX_STA_CONN
        int "Maximal STA connections"
        default 4
        help
            Max number of the STA connects to AP.
    config AXK_WIFI_AP_SSID
        string "WiFi AP SSID"
        default "test_ap"
    config AXK_WIFI_AP_PASS
        string "WiFi AP PASSWORD"
        default "12345678"
    config AXK_WIFI_AP_CHANNEL
        int "WIFI AP CHANNEL"
        range 1 13
        default 1
    config AXK_WIFI_SSID_HIDDEN_ENABLE
        bool "SSID HIDDEN ENABLE"
        default n            
    config AXK_WIFI_AP_IP
        string "SET WiFi AP IP"
        default "192.168.100.1"
endmenu
```
