## application/aithink_cloud_rd01_floor/vendor/bl616cl-32/sdk_config/defconfig
```kconfig
# Components
CONFIG_BFLB_LOG      =n
CONFIG_FREERTOS      =y
CONFIG_POSIX         =y
CONFIG_TLSF          =y
CONFIG_SHELL         =y
CONFIG_LWIP          =y
CONFIG_RF            =y
CONFIG_MBEDTLS       =y
CONFIG_DHCPD         =y
CONFIG_PING          =y
CONFIG_MDNS          =y

CONFIG_LITTLEFS     =y
CONFIG_BFLB_MTD     =y
CONFIG_PARTITION    =y
CONFIG_BFLB_OTA     =y
CONFIG_FOTA         =y


# wifi
CONFIG_VIF_MAX =2
CONFIG_STA_MAX =4
CONFIG_MAC_TXQ_DEPTH =32
CONFIG_MAC_RXQ_DEPTH =12

# ble
CONFIG_BLUETOOTH =1
#CONFIG_BTBLECONTROLLER_LIB =ble1m0s1bredr0
CONFIG_RF =1
CONFIG_BLE_USE_MAC2 =0
CONFIG_BLE_TP_SERVER =1
CONFIG_BTBLECONTROLLER_LIB =m2s1
CONFIG_BT_FIXED_PASSKEY =y


ifeq ($(CHIP),bl602)
    CONFIG_WIFI4=y
else
    CONFIG_WIFI6=y
    CONFIG_MACSW_SELECT = default
    ifeq ($(CONFIG_WL80211),y)
        CONFIG_BL_WPA_SUPPLICANT =y
    else
        CONFIG_FHOST=y
    endif
endif

ifeq ($(CHIP),bl616d)
    CONFIG_WRAM_FOR_AP_SIZE = 0x28000
endif

CONFIG_VSNPRINTF_FLOAT      =y
CONFIG_VSNPRINTF_FLOAT_EX   =y
CONFIG_VSNPRINTF_LONG_LONG  =y

# mbedtls
ifneq ($(CHIP),bl602)
CONFIG_MBEDTLS_AES_USE_HW    =y
CONFIG_MBEDTLS_BIGNUM_USE_HW =n
CONFIG_MBEDTLS_ECC_USE_HW    =y
CONFIG_MBEDTLS_SHA1_USE_HW   =y
CONFIG_MBEDTLS_SHA256_USE_HW =y
CONFIG_MBEDTLS_SHA512_USE_HW =y
endif

#ws add
CONFIG_MBEDTLS_AES_USE_HW    =n
CONFIG_MBEDTLS_BIGNUM_USE_HW =n
CONFIG_MBEDTLS_ECC_USE_HW    =n
CONFIG_MBEDTLS_SHA1_USE_HW   =n
CONFIG_MBEDTLS_SHA256_USE_HW =n
CONFIG_MBEDTLS_SHA512_USE_HW =n
```

## application/at_demo/vendor/bl616cl-32/app_config/Kconfig
```kconfig
menu "application"
    config AT_FW_VER
        string "AT FW Version"
        default ""
    config AT_SDK_VER
        string "AT SDK Version"
        default ""
    config AT_WIFI_CMD_ENABLE
        bool "ENABLE AT WIFI"
        default y
    config AT_BLE_CMD_ENABLE
        bool "ENABLE AT BLE"
        default y
    config AT_HTTP_CMD_ENABLE
        bool "ENABLE AT HTTP"
        default y
    config AT_MQTT_CMD_ENABLE
        bool "ENABLE AT MQTT"
        default y
    config AT_SOCKET_CMD_ENABLE
        bool "ENABLE AT SOCKET"
        default y
endmenu
```

## application/cjson_demo/vendor/rtl8711dx/app_config/Kconfig
```kconfig
menu "application"
    config AT_FW_VER
        string "AT FW Version"
        default "\"debug\""
    config AT_WIFI_CMD_ENABLE
        bool "ENABLE AT WIFI"
        default y
    config AT_BLE_CMD_ENABLE
        bool "ENABLE AT BLE"
        default y
    config AT_HTTP_CMD_ENABLE
        bool "ENABLE AT HTTP"
        default y
    config AT_MQTT_CMD_ENABLE
        bool "ENABLE AT MQTT"
        default y
    config AT_SOCKET_CMD_ENABLE
        bool "ENABLE AT SOCKET"
        default y
endmenu
```

## application/flash_demo/vendor/bl602/app_config/Kconfig
```kconfig
menu "application"
    config FLASH_RW_START_ADDR
            hex "Flash rw start addr"
            default 0x2C2000
endmenu
```

## application/harmonyos_ble_demo/vendor/bl602/app_config/Kconfig
```kconfig
menu "application"
    menu "led config"
        config GPIO_R_LED_PORT
                string "set red led gpio port"
                default AIIO_GPIO_A

        config GPIO_R_LED_PIN
                string "set red led gpio pin"
                default AIIO_GPIO_NUM_14

        config GPIO_G_LED_PORT
                string "set green led gpio port"
                default AIIO_GPIO_A

        config GPIO_G_LED_PIN
                string "set green led gpio pin"
                default AIIO_GPIO_NUM_17

        config GPIO_B_LED_PORT
                string "set blue led gpio port"
                default AIIO_GPIO_A

        config GPIO_B_LED_PIN
                string "set blue led gpio pin"
                default AIIO_GPIO_NUM_3
    endmenu

    menu "key config"
        config KEY_PORT
                string "set key port"
                default AIIO_GPIO_A
        config KEY_PIN
                string "set key pin"
                default AIIO_GPIO_NUM_8
    endmenu
endmenu
```

## application/pwm_demo/vendor/rtl8711dx/app_config/Kconfig
```kconfig
menu "application"

menuconfig BSP_USING_PERIPHERAL
    bool "Enable peripheral"
    default y
    if BSP_USING_PERIPHERAL
        config BSP_USING_CONFIG
            bool "Use menuconfig to generate the configuration"
            default y
    endif
    if BSP_USING_PERIPHERAL
        config TEST_PWM0_PORT
            string "pwm0 out port"
            default AIIO_GPIO_A
            depends on BSP_USING_CONFIG
            help 
            test pwm0 port
        config TEST_PWM0
            string "pwm out function"
            default AIIO_GPIO_NUM_8
            depends on BSP_USING_CONFIG
            help 
            test pwm function
    endif

endmenu
```

## application/rd01_at_demo/vendor/bl602/app_config/Kconfig
```kconfig
menu "application"
    config AT_WIFI_CMD_ENABLE
        bool "ENABLE AT WIFI"
        default y
    config AT_BLE_CMD_ENABLE
        bool "ENABLE AT BLE"
        default y
    config AT_HTTP_CMD_ENABLE
        bool "ENABLE AT HTTP"
        default y
    config AT_MQTT_CMD_ENABLE
        bool "ENABLE AT MQTT"
        default y
    config AT_SOCKET_CMD_ENABLE
        bool "ENABLE AT SOCKET"
        default y

    choice RADAR_CMD_MODE
        bool "Radar CMD Mode config"
        default CMD_RADAR_MODE

    config CMD_RADAR_MODE
        bool "RADAR_MODE"
    config CMD_AT_MODE
        bool "AT_MODE"
    endchoice

    config RADAR_CMD_MODE
        int
        default 0 	if CMD_RADAR_MODE
        default 1 	if CMD_AT_MODE
endmenu
```

## application/rd_demo/vendor/bl602/app_config/Kconfig
```kconfig
menu "application"
    config AIIO_RADAR
        bool "ENABLE RADAR"
        default y
    config RADAR_UART_ENABLE
        bool "ENABLE RADAR UART"
        default y
    config RADAR_UART
        int "RADAR UART NUM"
    default 1
    config RADAR_UART_BAUDRATE
        int "RADAR UART BAUDRATE"
    default 256000
endmenu
```

## application/tencentcloud_iot_demo/vendor/bl602/app_config/Kconfig
```kconfig
menu "application"
    menu "wifi config"
        config AXK_WIFI_STA_SSID
            string "WiFi Connect SSID"
            default "myssid"
            help
                SSID (network name) for the example to connect to.

        config AXK_WIFI_STA_PASS
            string "WiFi Connect Password"
            default "mypassword"
            help
                WiFi password (WPA or WPA2) for the example to use.
        config AXK_WIFI_STA_CHANNEL
            int "WiFi Connect Channel"
            range 1 13
            default 1
            help
                WiFi channel (network channel) for the example to use.

        config AXK_WIFI_MAX_STA_CONN
            int "Maximal STA connections"
            default 4
            help
                Max number of the STA connects to AP.

        config AXK_WIFI_AP_SSID
            string "WiFi AP SSID"
            default "test_ap"

        config AXK_WIFI_AP_PASS
            string "WiFi AP PASSWORD"
            default "12345678"

        config AXK_WIFI_AP_CHANNEL
            int "WIFI AP CHANNEL"
            range 1 13
            default 1

        config AXK_WIFI_SSID_HIDDEN_ENABLE
            bool "SSID HIDDEN ENABLE"
            default n            

        config AXK_WIFI_AP_IP
            string "SET WiFi AP IP"
            default "192.168.100.1"
    endmenu

    menu "button config"
        config GPIO_BUTTON_PORT
                string "set red led gpio port"
                default AIIO_GPIO_A

        config GPIO_BUTTON_PIN
                string "set red led gpio pin"
                default AIIO_GPIO_NUM_0
    endmenu

    menu "led config"
        config GPIO_R_LED_PORT
                string "set red led gpio port"
                default AIIO_GPIO_A

        config GPIO_R_LED_PIN
                string "set red led gpio pin"
                default AIIO_GPIO_NUM_0

        config GPIO_G_LED_PORT
                string "set red led gpio port"
                default AIIO_GPIO_A

        config GPIO_G_LED_PIN
                string "set red led gpio pin"
                default AIIO_GPIO_NUM_0

        config GPIO_B_LED_PORT
                string "set red led gpio port"
                default AIIO_GPIO_A

        config GPIO_B_LED_PIN
                string "set red led gpio pin"
                default AIIO_GPIO_NUM_0
    endmenu

    menu "Data start address"
        config FLASH_RW_START_ADDR
            hex "Flash rw start addr"
            default 0x1f3000
        config FLASH_REGION_SIZE
            hex "flash region size"
            default 0x1000
    endmenu

    menu "chip platform"
        config DEVICE_TYPE
            string "chip platform"
            default "bl602"
    endmenu

    menu "at_uart config"
        config AT_UART
            string "at uart index"
            default AIIO_UART0
            
        config AT_TX_PIN
                string "set at uart tx pin"
                default AIIO_GPIO_NUM_0

        config AT_RX_PIN
                string "set at uart rx pin"
                default AIIO_GPIO_NUM_0

        config AT_BAUDRATE
            int "at uart baudrate"
            default 921600

        config AT_RECEIVE_BUFFER_MAX_LEN
            int "at uart receive buffer max length"
            default 1024
    endmenu

    menu "module config"
        config WAN_NETWORK_MODULE
                bool "wan network enable"
                default y

        config LAN_NETWORK_MODULE
                bool "LAN network enable"
                default y

        config BLE_DISTRIBUTION_NETWORK
                bool "ble distribution network enable"
                default y

        config AP_DISTRIBUTION_NETWORK
                bool "ap distribution network enable"
                default y

        config OTA_MODULE
                bool "ota module enable"
                default y

    endmenu

endmenu
```

## application/tencentcloud_iot_demo/vendor/rtl8711dx/app_config/Kconfig
```kconfig
menu "application"
    menu "wifi config"
        config AXK_WIFI_STA_SSID
            string "WiFi Connect SSID"
            default "myssid"
            help
                SSID (network name) for the example to connect to.

        config AXK_WIFI_STA_PASS
            string "WiFi Connect Password"
            default "mypassword"
            help
                WiFi password (WPA or WPA2) for the example to use.
        config AXK_WIFI_STA_CHANNEL
            int "WiFi Connect Channel"
            range 1 13
            default 1
            help
                WiFi channel (network channel) for the example to use.

        config AXK_WIFI_MAX_STA_CONN
            int "Maximal STA connections"
            default 4
            help
                Max number of the STA connects to AP.

        config AXK_WIFI_AP_SSID
            string "WiFi AP SSID"
            default "test_ap"

        config AXK_WIFI_AP_PASS
            string "WiFi AP PASSWORD"
            default "12345678"

        config AXK_WIFI_AP_CHANNEL
            int "WIFI AP CHANNEL"
            range 1 13
            default 1

        config AXK_WIFI_SSID_HIDDEN_ENABLE
            bool "SSID HIDDEN ENABLE"
            default n            

        config AXK_WIFI_AP_IP
            string "SET WiFi AP IP"
            default "192.168.100.1"
    endmenu

    menu "button config"
        config GPIO_BUTTON_PORT
                string "set button gpio port"
                default AIIO_GPIO_A

        config GPIO_BUTTON_PIN
                string "set button gpio pin"
                default AIIO_GPIO_NUM_30
    endmenu

    menu "led config"
        config GPIO_R_LED_PORT
                string "set red led gpio port"
                default AIIO_GPIO_A

        config GPIO_R_LED_PIN
                string "set red led gpio pin"
                default AIIO_GPIO_NUM_12

        config GPIO_G_LED_PORT
                string "set green led gpio port"
                default AIIO_GPIO_A

        config GPIO_G_LED_PIN
                string "set green led gpio pin"
                default AIIO_GPIO_NUM_14

        config GPIO_B_LED_PORT
                string "set blue led gpio port"
                default AIIO_GPIO_A

        config GPIO_B_LED_PIN
                string "set blue led gpio pin"
                default AIIO_GPIO_NUM_13
    endmenu

    menu "Data start address"
        config FLASH_RW_START_ADDR
            hex "Flash rw start addr"
            default 0x200000
        config FLASH_REGION_SIZE
            hex "flash region size"
            default 0x1000
    endmenu

    menu "chip platform"
        config DEVICE_TYPE
            string "chip platform"
            default "rtl8711dx"
    endmenu

    menu "at_uart config"
        config AT_UART
            string "at uart index"
            default AIIO_UART0
            
        config AT_TX_PIN
                string "set at uart tx pin"
                default AIIO_GPIO_NUM_0

        config AT_RX_PIN
                string "set at uart rx pin"
                default AIIO_GPIO_NUM_0

        config AT_BAUDRATE
            int "at uart baudrate"
            default 921600

        config AT_RECEIVE_BUFFER_MAX_LEN
            int "at uart receive buffer max length"
            default 1024
    endmenu

    menu "module config"
        config WAN_NETWORK_ENABLE
                bool "wan network enable"
                default y

        config LAN_NETWORK_ENABLE
                bool "LAN network enable"
                default y

        config BLE_DISTRIBUTION_NETWORK_ENABLE
                bool "ble distribution network enable"
                default y

        config AP_DISTRIBUTION_NETWORK_ENABLE
                bool "ap distribution network enable"
                default y

        config OTA_ENABLE
                bool "ota module enable"
                default y

    endmenu

endmenu
```

## application/wifi_sta_demo/vendor/bl602/app_config/Kconfig
```kconfig
menu "application"

    config AXK_WIFI_STA_SSID
        string "WiFi Connect SSID"
        default "myssid"
        help
            SSID (network name) for the example to connect to.

    config AXK_WIFI_STA_PASS
        string "WiFi Connect Password"
        default "mypassword"
        help
            WiFi password (WPA or WPA2) for the example to use.
    config AXK_WIFI_STA_CHANNEL
        int "WiFi Connect Channel"
        range 0 13
        default 0
        help
            WiFi channel (network channel) for the example to use.

    config AXK_WIFI_MAX_STA_CONN
        int "Maximal STA connections"
        default 4
        help
            Max number of the STA connects to AP.
endmenu
```
