## application/uart_demo/vendor/bl602/app_config/Kconfig
```kconfig
menu "application"

menuconfig BSP_USING_PERIPHERAL
    bool "Enable peripheral"
    default y
    if BSP_USING_PERIPHERAL
        config BSP_USING_CONFIG
            bool "Use menuconfig to generate the configuration"
            default y
    endif
    if BSP_USING_PERIPHERAL
        config USER_UART
            string "The number of the device outside the uart"
            default AIIO_UART1
            depends on BSP_USING_CONFIG
            help 
              The number of the device outside the uart
        config USER_UART_TX
            string "UART data send pin"
            default AIIO_GPIO_NUM_4
            depends on BSP_USING_CONFIG
            help 
              UART data send pin
        config USER_UART_RX
            string "UART data receive pin"
            default AIIO_GPIO_NUM_3
            depends on BSP_USING_CONFIG
            help 
              UART data receive pin
    endif

endmenu
```

## application/udp_server_demo/vendor/ln882h/app_config/Kconfig
```kconfig
menu "application"

    config AXK_WIFI_SSID
        string "WiFi Connect SSID"
        default "myssid"
        help
            SSID (network name) for the example to connect to.

    config AXK_WIFI_PASS
        string "WiFi Connect Password"
        default "mypassword"
        help
            WiFi password (WPA or WPA2) for the example to use.
                

endmenu
```

## application/wifi_ap_ble_salve/vendor/bl618/app_config/Kconfig
```kconfig
menu "application"

    config AXK_WIFI_MAX_STA_CONN
        int "Maximal STA connections"
        default 4
        help
            Max number of the STA connects to AP.
    config AXK_WIFI_AP_SSID
        string "WiFi AP SSID"
        default "test_ap"
    config AXK_WIFI_AP_PASS
        string "WiFi AP PASSWORD"
        default "12345678"
    config AXK_WIFI_AP_CHANNEL
        int "WIFI AP CHANNEL"
        range 1 13
        default 1
    config AXK_WIFI_SSID_HIDDEN_ENABLE
        bool "SSID HIDDEN ENABLE"
        default n            
    config AXK_WIFI_AP_IP
        string "SET WiFi AP IP"
        default "192.168.100.1"
endmenu
```

## application/wifi_sta_ble_salve/vendor/bl602/app_config/Kconfig
```kconfig
menu "application"

    config AXK_WIFI_STA_SSID
        string "WiFi Connect SSID"
        default "myssid"
        help
            SSID (network name) for the example to connect to.

    config AXK_WIFI_STA_PASS
        string "WiFi Connect Password"
        default "mypassword"
        help
            WiFi password (WPA or WPA2) for the example to use.
endmenu
```

## tools/platform_config/kconfig_flinux/Kconfig
```kconfig
# SPDX-License-Identifier: GPL-2.0
#
# For a description of the syntax of this configuration file,
# see Documentation/kbuild/kconfig-language.rst.
#
mainmenu "aithinker_dev_sdk Platform Configuration"


source "scripts/Kconfig.include"


source "../../../tmp/kconfig/adt_kconfig/Kconfig"

source "../../../tmp/kconfig/adt_kconfig/MKconfig"

source "../../../tmp/kconfig/application_kconfig/Kconfig"

source "../../../tmp/kconfig/common_kconfig/Kconfig"
```
